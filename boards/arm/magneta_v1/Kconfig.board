## boards/arm/magneta_v1/Kconfig.board
```kconfig
# Copyright (c) 2024 Nordic Semiconductor ASA
# SPDX-License-Identifier: Apache-2.0

config BOARD_MAGNETA_V1
	bool "magneta_v1"
	depends on SOC_NRF52832_QFAA

# config BOARD_ENABLE_DCDC
# 	bool "DCDC mode"
# 	select SOC_DCDC_NRF52X
# 	default y
```

## boards/arm/magneta_v1/Kconfig.defconfig
```kconfig
# Copyright (c) 2024 Nordic Semiconductor ASA
# SPDX-License-Identifier: Apache-2.0

if BOARD_MAGNETA_V1

config BOARD
	default "magneta_v1"

config BT_CTLR
   default BT


endif
```
